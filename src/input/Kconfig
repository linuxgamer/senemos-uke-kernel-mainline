## src/input/Kconfig
```kconfig
# SPDX-License-Identifier: GPL-2.0-or-later
config TOUCHSCREEN_NT36532_UKE
	tristate "Uke NT36532 native touchscreen"
	depends on SPI && OF && GPIOLIB && INPUT_TOUCHSCREEN && POWER_SUPPLY && DRM_PANEL_XIAOMI_O82
	select VIDEOBUF2_VMALLOC
	select CRYPTO_LIB_SHA256
	help
	  Load the selected CSOT or Tianma OEM firmware and report multitouch directly
	  through Linux input. No userspace contact processor or private baseline
	  is required. Firmware gestures report KEY_WAKEUP.
```

## src/sensors/Kconfig
```kconfig
# SPDX-License-Identifier: GPL-2.0-only
config IIO_UKE_SSC
	tristate "Xiaomi Uke firmware-owned SSC sensors"
	depends on ARM64 && ARCH_QCOM && OF && IIO && QRTR && QCOM_QMI_HELPERS
	select IIO_BUFFER
	select IIO_KFIFO_BUF
	help
	  Discover sensors through the existing ADSP SSC QMI service and expose
	  metadata-qualified measurements through IIO. Firmware retains sensor-bus
	  and calibration ownership. No registry or calibration writes are added.
```
