// SPDX-License-Identifier: GPL-2.0-only
/* Both O82 suppliers share these OEM timings; ON packets remain supplier-specific. */
#include "sm7675-uke-native-display.dtso"
#include "../input/sm7675-uke-thp.dtsi"

&uke_panel {
	/delete-property/ xiaomi,initial-60hz-only;
	xiaomi,oem-refresh-modes;
};

/* Cliffs OEM core-clock ceiling; the existing DISPCC table supplies its vote. */
&uke_mdp_opps {
	opp-600000000 { opp-hz = /bits/ 64 <600000000>; };
};

#ifdef UKE_AUDIO_SERVICES
#include "../audio/sm7675-uke-audio-services.dtsi"
#endif
#ifdef UKE_AUDIO_CARD
#include "../audio/sm7675-uke-audio-card.dtsi"
#endif
#ifdef UKE_AUDIO_HDMI
#include "../audio/sm7675-uke-hdmi-audio.dtsi"
#endif
#ifdef UKE_AUDIO_SPEAKERS
#include "../audio/sm7675-uke-speaker-audio.dtsi"
#endif
#ifdef UKE_AUDIO_MICROPHONES
#include "../audio/sm7675-uke-microphone-audio.dtsi"
#endif
